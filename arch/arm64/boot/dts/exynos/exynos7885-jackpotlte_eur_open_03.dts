/*
 * SAMSUNG UNIVERSAL7885 board device tree source
 *
 * Copyright (c) 2013 Samsung Electronics Co., Ltd.
 *		http://www.samsung.com
 *
 * This program is free software; you can redistribute it and/or modify
 * it under the terms of the GNU General Public License version 2 as
 * published by the Free Software Foundation.
*/

/dts-v1/;
#include "exynos7885-jackpotlte_common.dtsi"
#include "exynos7885-jackpotlte_eur_can_common.dts"
//Actually common
//#include "exynos7885-jackpotlte_fingerprint-sensor_00.dtsi"
//#include "exynos7885-jackpotlte_eur_open_gpio_03.dtsi"
//Actually common
//#include "exynos7885-jackpotlte_mst_02.dtsi"
//Actually common
//#include "exynos7885-jackpotlte_svcled.dtsi"

/ {
	model = "Samsung JACKPOTLTE EUR rev03 board based on EXYNOS7885";
	model_info-chip = <7885>;
	model_info-platform = "android";
	model_info-subtype = "samsung";
	model_info-hw_rev = <3>;
	model_info-hw_rev_end = <3>;
	compatible = "samsung, JACKPOTLTE EUR rev03", "samsung,Universal7885";

	//TODO stuff
};
